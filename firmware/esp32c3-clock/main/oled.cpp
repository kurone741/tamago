#include "oled.h"

#include <cstring>
#include <initializer_list>
#include "driver/i2c_master.h"
#include "esp_check.h"
#include "esp_log.h"
#include "config.h"

namespace oled {
static const char* TAG = "oled";

static i2c_master_bus_handle_t s_bus;
static i2c_master_dev_handle_t s_dev;
static uint8_t s_fb[W * H / 8];
static uint8_t s_shadow[W * H / 8];
static uint8_t s_tx[1 + sizeof(s_fb)];

static esp_err_t send_cmds(std::initializer_list<uint8_t> c) {
    uint8_t b[24];
    size_t n = 0;
    b[n++] = 0x00;  // control byte: command stream
    for (uint8_t v : c) b[n++] = v;
    return i2c_master_transmit(s_dev, b, n, 100);
}

esp_err_t init() {
    i2c_master_bus_config_t bc = {};
    bc.i2c_port = OLED_I2C_PORT;
    bc.sda_io_num = PIN_OLED_SDA;
    bc.scl_io_num = PIN_OLED_SCL;
    bc.clk_source = I2C_CLK_SRC_DEFAULT;
    bc.glitch_ignore_cnt = 7;
    bc.flags.enable_internal_pullup = true;
    ESP_RETURN_ON_ERROR(i2c_new_master_bus(&bc, &s_bus), TAG, "i2c bus");

    i2c_device_config_t dc = {};
    dc.dev_addr_length = I2C_ADDR_BIT_LEN_7;
    dc.device_address = OLED_I2C_ADDR;
    dc.scl_speed_hz = OLED_I2C_HZ;
    ESP_RETURN_ON_ERROR(i2c_master_bus_add_device(s_bus, &dc, &s_dev), TAG, "i2c dev");

    const uint8_t seg = OLED_ROTATE_180 ? 0xA0 : 0xA1;
    const uint8_t com = OLED_ROTATE_180 ? 0xC0 : 0xC8;
    ESP_RETURN_ON_ERROR(send_cmds({0xAE}), TAG, "off");
    send_cmds({0xD5, 0x80});        // clock divide / osc
    send_cmds({0xA8, 0x3F});        // mux 64
    send_cmds({0xD3, 0x00});        // display offset
    send_cmds({0x40});              // start line 0
    send_cmds({0x8D, 0x14});        // charge pump on
    send_cmds({0x20, 0x00});        // horizontal addressing
    send_cmds({seg});
    send_cmds({com});
    send_cmds({0xDA, 0x12});        // COM pins
    send_cmds({0x81, 0xCF});        // contrast
    send_cmds({0xD9, 0xF1});        // precharge
    send_cmds({0xDB, 0x40});        // vcomh
    send_cmds({0xA4});              // follow RAM
    send_cmds({0xA6});              // normal (not inverted)
    send_cmds({0xAF});              // on

    memset(s_shadow, 0xFF, sizeof(s_shadow));  // force first flush
    clear();
    flush();
    return ESP_OK;
}

void clear() { memset(s_fb, 0, sizeof(s_fb)); }

void flush() {
    if (memcmp(s_fb, s_shadow, sizeof(s_fb)) == 0) return;
    send_cmds({0x21, 0, W - 1});
    send_cmds({0x22, 0, H / 8 - 1});
    s_tx[0] = 0x40;  // control byte: data stream
    memcpy(s_tx + 1, s_fb, sizeof(s_fb));
    if (i2c_master_transmit(s_dev, s_tx, sizeof(s_tx), 200) == ESP_OK)
        memcpy(s_shadow, s_fb, sizeof(s_fb));
}

void invert(bool on) { send_cmds({static_cast<uint8_t>(on ? 0xA7 : 0xA6)}); }

void pixel(int x, int y, bool on) {
    if (x < 0 || x >= W || y < 0 || y >= H) return;
    uint8_t& b = s_fb[(y >> 3) * W + x];
    if (on) b |= (1 << (y & 7));
    else    b &= ~(1 << (y & 7));
}

void fill_rect(int x, int y, int w, int h, bool on) {
    for (int j = y; j < y + h; j++)
        for (int i = x; i < x + w; i++) pixel(i, j, on);
}

void rect(int x, int y, int w, int h, bool on) {
    fill_rect(x, y, w, 1, on);
    fill_rect(x, y + h - 1, w, 1, on);
    fill_rect(x, y, 1, h, on);
    fill_rect(x + w - 1, y, 1, h, on);
}

// Classic 5x7 font, ASCII 0x20..0x5A, one byte per column, LSB = top row.
static const uint8_t kFont[][5] = {
    {0x00,0x00,0x00,0x00,0x00}, {0x00,0x00,0x5F,0x00,0x00}, {0x00,0x07,0x00,0x07,0x00}, {0x14,0x7F,0x14,0x7F,0x14},
    {0x24,0x2A,0x7F,0x2A,0x12}, {0x23,0x13,0x08,0x64,0x62}, {0x36,0x49,0x56,0x20,0x50}, {0x00,0x05,0x03,0x00,0x00},
    {0x00,0x1C,0x22,0x41,0x00}, {0x00,0x41,0x22,0x1C,0x00}, {0x14,0x08,0x3E,0x08,0x14}, {0x08,0x08,0x3E,0x08,0x08},
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    {0x07,0x08,0x70,0x08,0x07}, {0x61,0x51,0x49,0x45,0x43},
};
static_assert(sizeof(kFont) / 5 == 0x5A - 0x20 + 1, "font table size");

static void glyph(int x, int y, char c, int scale, bool on) {
    if (c >= 'a' && c <= 'z') c -= 32;
    if (c < 0x20 || c > 'Z') c = '?';
    const uint8_t* g = kFont[c - 0x20];
    for (int col = 0; col < 5; col++)
        for (int row = 0; row < 7; row++)
            if (g[col] & (1 << row)) fill_rect(x + col * scale, y + row * scale, scale, scale, on);
}

int text_width(const char* s, int scale, int gap) {
    int n = strlen(s);
    return n ? n * (5 * scale + gap) - gap : 0;
}

void text(int x, int y, const char* s, int scale, int gap, bool on) {
    for (; *s; s++, x += 5 * scale + gap) glyph(x, y, *s, scale, on);
}

void text_centered(int y, const char* s, int scale, int gap, bool on) {
    text((W - text_width(s, scale, gap)) / 2, y, s, scale, gap, on);
}
}  // namespace oled
