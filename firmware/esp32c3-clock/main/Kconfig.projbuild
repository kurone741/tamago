## firmware/esp32c3-clock/main/Kconfig.projbuild
```kconfig
menu "Clock Settings"

    config CLOCK_WIFI_SSID
        string "Wi-Fi SSID (empty = no Wi-Fi, manual time only)"
        default ""

    config CLOCK_WIFI_PASSWORD
        string "Wi-Fi password (empty = open network)"
        default ""

    config CLOCK_NTP_SERVER
        string "NTP server"
        default "pool.ntp.org"

    config CLOCK_TZ
        string "POSIX timezone string"
        default "UTC0"
        help
            POSIX TZ string, e.g. "UTC0" or "CET-1CEST,M3.5.0,M10.5.0".
            Note the POSIX sign convention (zones west of UTC are positive).

endmenu
```
